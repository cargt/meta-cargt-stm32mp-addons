## conf/layer.conf
```bitbake
# We have a conf and classes directory, add to BBPATH
BBPATH .= ":${LAYERDIR}"

# We have a recipes-* directories, add to BBFILES
BBFILES += "${LAYERDIR}/recipes-*/*/*.bb \
	${LAYERDIR}/recipes-*/*/*.bbappend"

BBFILE_COLLECTIONS += "stm-st-stm32mp-00365v3"
BBFILE_PATTERN_stm-st-stm32mp-00365v3 := "^${LAYERDIR}/"
BBFILE_PRIORITY_stm-st-stm32mp-00365v3 = "7"

EULA_FILE_ST:stm32mpcommonmx = "${LAYERDIR}/conf/eula/${MACHINE}"
EULA_FILE_ST_MD5SUM:stm32mpcommonmx = "8b505090fb679839cefbcc784afe8ce9"

# This should only be incremented on significant changes that will
# cause compatibility issues with other layers
LAYERVERSION_stm-st-stm32mp-00365v3 = "1"
LAYERSERIES_COMPAT_stm-st-stm32mp-00365v3 = "scarthgap"

LAYERDEPENDS_stm-st-stm32mp-00365v3 = "stm-st-stm32mp"

# OpenSTLinux compatibility version
ST_OSTL_COMPATIBILITY_VERSION_stm-st-stm32mp-00365v3 = "6.1"
```
