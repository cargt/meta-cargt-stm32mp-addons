// SPDX-License-Identifier: (GPL-2.0+ OR MIT)
/*
 * Copyright 2022 NXP
 */

 /dts-v1/;

 #include <dt-bindings/usb/pd.h>
 #include <dt-bindings/pwm/pwm.h>
 #include "stm32mp257f-cargt-00395-02-00365.dts"
 #include "stm32mp257f-cargt-00395-02-00365-glt1011280800is1.dtsi"
 
/ {
	model = "Cargt STM32MP257F SOM (00395-02) on 00365 10-in LVDS Display(GLT10111280800IS1-CTP)";
};
