// SPDX-License-Identifier: (GPL-2.0-only OR BSD-3-Clause)
/*
 * Per-panel U-Boot devicetree: the board devicetree plus a panel-specific
 * first compatible. U-Boot's board_late_init() turns that compatible into
 * fdtfile, so Linux boots the kernel devicetree of the same name.
 */

#include "stm32mp257f-cargt-00395-02-00365.dts"

/ {
	compatible = "cargt,stm32mp257f-cargt-00395-02-00365-glt0557201280is1", "cargt,stm32mp257f-cargt-00395-02-00365", "st,stm32mp257";
};
