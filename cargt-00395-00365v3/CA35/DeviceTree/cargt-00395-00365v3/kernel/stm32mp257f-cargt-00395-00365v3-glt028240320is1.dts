// SPDX-License-Identifier: (GPL-2.0+ OR MIT)
/*
 * Copyright 2022 NXP
 */

/dts-v1/;

#include <dt-bindings/usb/pd.h>
#include "stm32mp257f-cargt-00395-00365v3.dts"
#include "stm32mp257f-cargt-00395-00365v3-glt028240320is1.dtsi"

/ {
	model = "Cargt STM32MP257F SOM (00395) on 00365v3 with 2.8 inch SPI TFT (GLT028240320IS1)";
};
