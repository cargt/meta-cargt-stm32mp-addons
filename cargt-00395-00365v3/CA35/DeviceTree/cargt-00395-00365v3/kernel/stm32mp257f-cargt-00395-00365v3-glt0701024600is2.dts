// SPDX-License-Identifier: (GPL-2.0+ OR MIT)
/*
 * Copyright 2022 NXP
 */

 /dts-v1/;

 #include <dt-bindings/usb/pd.h>
 #include <dt-bindings/pwm/pwm.h>
 #include "stm32mp257f-cargt-00395-00365v3.dts"
 #include "stm32mp257f-cargt-00395-00365v3-glt0701024600is2.dtsi"
 
/ {
	model = "Cargt STM32MP257F SOM (00395) on 00365v3 with 7-in LVDS Display(GLT0701024600IS2-CTP)";
};
