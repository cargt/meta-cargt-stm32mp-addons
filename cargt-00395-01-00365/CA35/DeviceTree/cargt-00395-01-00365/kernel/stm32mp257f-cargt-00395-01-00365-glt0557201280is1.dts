// SPDX-License-Identifier: (GPL-2.0+ OR MIT)
/*
 * Copyright 2022 NXP
 */

 /dts-v1/;

 #include <dt-bindings/usb/pd.h>
 #include <dt-bindings/pwm/pwm.h>
 #include "stm32mp257f-cargt-00395-01-00365.dts"
 #include "stm32mp257f-cargt-00395-01-00365-glt0557201280is1.dtsi"
 
/ {
	model = "Cargt STM32MP257F SOM (00395-01) on 00365 with 5.5 inch MIPI DSI Display (GLT0557201280IS1)";
};
